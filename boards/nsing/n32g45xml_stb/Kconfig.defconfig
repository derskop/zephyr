## boards/nsing/n32g45xml_stb/Kconfig.defconfig
```kconfig
# Copyright (c) 2026 Nations Technologies Inc.
# SPDX-License-Identifier: Apache-2.0

configdefault NET_L2_ETHERNET
	default y if DT_HAS_NSING_N32_ETH_ENABLED
```

## boards/nsing/n32g45xml_stb/Kconfig.n32g45xml_stb
```kconfig
# Copyright (c) 2016 Linaro Limited.
# SPDX-License-Identifier: Apache-2.0

config BOARD_N32G45XML_STB
	select SOC_N32G457MEL
```

## boards/nsing/n32g45xml_stb/board.yml
```yaml
board:
  name: n32g45xml_stb
  full_name: N32G45X Discovery
  vendor: nsing
  socs:
    - name: n32g457
```

## boards/nsing/n32g45xml_stb/n32g45xml_stb_defconfig
```kconfig
# SPDX-License-Identifier: Apache-2.0


CONFIG_GPIO=y
CONFIG_GPIO_N32=y

# 时钟
CONFIG_CLOCK_CONTROL=y
CONFIG_CLOCK_CTRL_N32=y

CONFIG_SERIAL=y
CONFIG_CONSOLE=y
CONFIG_UART_CONSOLE=y

CONFIG_I2C=y

CONFIG_PWM=y
```

## drivers/adc/Kconfig.n32
```kconfig
# Copyright (c) 2026 Nations Technologies
# SPDX-License-Identifier: Apache-2.0

config ADC_N32
	bool "Nations N32G45x ADC driver"
	default y
	depends on DT_HAS_NSING_N32_ADC_ENABLED
	select PINCTRL
	select USE_NSING_ADC
	help
	  Enable polling ADC conversions on the N32G45x ADC controllers.
```

## drivers/can/Kconfig.n32
```kconfig
# N32 CAN configuration options
#
# Copyright (c) 2026
# SPDX-License-Identifier: Apache-2.0

config CAN_N32_BXCAN
	bool "N32 bxCAN driver"
	default y
	depends on DT_HAS_NSING_N32_BXCAN_ENABLED
	select PINCTRL
	select USE_NSING_CAN
	help
	  Enable the Nations Technologies N32 bxCAN Driver.

if CAN_N32_BXCAN

config CAN_N32_BXCAN_MAX_STD_ID_FILTERS
	int "Maximum number of standard (11-bit) ID filters"
	default 14
	range 0 14
	help
	  Defines the maximum number of filters with standard ID (11-bit)
	  that can be added by the application.

	  One standard ID filter with mask occupies 1/2 of a filter bank.
	  Each N32 CAN instance provides 14 independent filter banks.

	  The following equation determines the maximum total number of
	  filters:

	  CAN_N32_BXCAN_MAX_STD_ID_FILTERS + CAN_N32_BXCAN_MAX_EXT_ID_FILTERS * 2 <= 28

config CAN_N32_BXCAN_MAX_EXT_ID_FILTERS
	int "Maximum number of extended (29-bit) ID filters"
	default 7
	range 0 14
	help
	  Defines the maximum number of filters with extended ID (29-bit)
	  that can be added by the application.

	  One extended ID filter with mask occupies 1 of the 14 available
	  filter banks.

	  The following equation determines the maximum total number of
	  filters:

	  CAN_N32_BXCAN_MAX_STD_ID_FILTERS + CAN_N32_BXCAN_MAX_EXT_ID_FILTERS * 2 <= 28

endif # CAN_N32_BXCAN
```

## drivers/clock_control/Kconfig.n32
```kconfig
# Copyright (c) 2024 Nations Technologies
# SPDX-License-Identifier: Apache-2.0

config CLOCK_CTRL_N32
	bool "N32 clock controller driver"
	default y
	depends on DT_HAS_NSING_N32_RCC_ENABLED
	help
	  Enable the Nations Technologies N32 Reset and Clock Control (RCC)
	  driver.
```

## drivers/comparator/Kconfig.n32
```kconfig
# Copyright (c) 2026 Nations Technologies
# SPDX-License-Identifier: Apache-2.0

config COMPARATOR_N32
	bool "Nations N32G45x comparator driver"
	default y
	depends on DT_HAS_NSING_N32_COMP_ENABLED
	select PINCTRL
	select USE_NSING_COMP
	help
	  Enable the comparator (COMP) driver for the Nations N32G45x SoC.
	  Each of the 7 comparators is a separate Zephyr comparator device.
```

## drivers/crc/Kconfig.n32
```kconfig
# Copyright (c) 2024 Nations Technologies
# SPDX-License-Identifier: Apache-2.0

menuconfig CRC_N32
	bool "N32 CRC driver"
	default y
	depends on DT_HAS_NSING_N32_CRC_ENABLED
	select USE_NSING_CRC
	select CRC_DRIVER_HAS_CRC32_MPEG2
	help
	  Enables Nations Technologies N32 family CRC driver.

	  The N32G45 CRC unit only implements the CRC-32/MPEG-2 algorithm
	  (fixed polynomial 0x04C11DB7, non-reflected, no final XOR), so
	  only the CRC32_MPEG2 computation type is supported.
```

## drivers/dac/Kconfig.n32
```kconfig
# Copyright (c) 2026 Nations Technologies
# SPDX-License-Identifier: Apache-2.0

config DAC_N32
	bool "Nations N32G45x DAC driver"
	default y
	depends on DT_HAS_NSING_N32_DAC_ENABLED
	select PINCTRL
	select USE_NSING_DAC
	help
	  Enable the two-channel N32G45x DAC driver.
```

## drivers/dma/Kconfig.n32
```kconfig
# Copyright (c) 2024 Nations Technologies
# SPDX-License-Identifier: Apache-2.0

config DMA_N32
	bool "Nations N32 DMA driver"
	default y
	depends on DT_HAS_NSING_N32_DMA_ENABLED
	select USE_NSING_DMA
	help
	  DMA driver for Nations N32 series MCUs.
```

## drivers/ethernet/Kconfig.n32
```kconfig
# Copyright (c) 2026 Nations Technologies
# SPDX-License-Identifier: Apache-2.0

menuconfig ETH_N32
	bool "Nations N32 Ethernet driver"
	default y
	depends on DT_HAS_NSING_N32_ETH_ENABLED
	select USE_NSING_ETH
	select PINCTRL
	select NET_CHECKSUM_OFFLOAD_SUPPORTED if NET_L2_ETHERNET
	help
	  Ethernet driver for Nations N32 series MCUs.

if ETH_N32

config ETH_N32_RX_THREAD_STACK_SIZE
	int "RX thread stack size"
	default 1500
	help
	  RX thread stack size in bytes.

config ETH_N32_RX_THREAD_PRIO
	int "RX thread priority"
	default 2
	help
	  RX thread priority.

config ETH_N32_MULTICAST_FILTER
	bool "Multicast hash filter support"
	select CRC
	help
	  Enable support for multicast hash filtering in the MAC.
	  Once enabled the ethernet MAC performs imperfect filtering
	  based on a computed hash of the destination MAC address of
	  the multicast address. Only multicast with the computed
	  hash set in the multicast table will be received and all
	  other multicast is dropped by the MAC. If disabled then all
	  multicast is received by the MAC.

config ETH_N32_HW_CHECKSUM
	bool "Use TX and RX hardware checksum"
	depends on NET_CHECKSUM_OFFLOAD
	help
	  Enable receive and transmit checksum offload to enhance throughput
	  performances.
	  See reference manual for more information on this feature.

endif # ETH_N32
```

## drivers/ethernet/mdio/Kconfig.n32
```kconfig
# Copyright (c) 2026 Nations Technologies
# SPDX-License-Identifier: Apache-2.0

config MDIO_N32
	bool "Nations N32 MDIO controller driver"
	default y
	depends on DT_HAS_NSING_N32_MDIO_ENABLED
	depends on ETH_N32
	select PINCTRL
	help
	  MDIO driver for Nations N32 series MCUs.
```

## drivers/flash/Kconfig.n32
```kconfig
# Copyright (c) 2026 Nations Technologies
# SPDX-License-Identifier: Apache-2.0

config SOC_FLASH_N32
	bool "Nations Technologies N32 flash driver"
	default y
	depends on SOC_FAMILY_NSING_N32
	depends on DT_HAS_NSING_N32_FLASH_CONTROLLER_ENABLED
	select FLASH_HAS_DRIVER_ENABLED
	select FLASH_HAS_EXPLICIT_ERASE
	select FLASH_HAS_PAGE_LAYOUT
	select MPU_ALLOW_FLASH_WRITE if ARM_MPU
	select USE_NSING_FLASH
	help
	  Enable the embedded flash driver for Nations Technologies N32 SoCs.
```

## drivers/gpio/Kconfig.n32
```kconfig
# Copyright (c) 2024 Nations Technologies
# SPDX-License-Identifier: Apache-2.0

config GPIO_N32
	bool "N32 GPIO driver"
	default y
	depends on DT_HAS_NSING_N32_GPIO_ENABLED
	help
	  Enable the Nations Technologies N32 GPIO driver.
```

## drivers/hwinfo/Kconfig.n32
```kconfig
# Copyright (c) 2026 Nations Technologies
# SPDX-License-Identifier: Apache-2.0

config HWINFO_N32
	bool "Nations Technologies N32 hardware information"
	default y
	depends on SOC_FAMILY_NSING_N32
	select HWINFO_HAS_DRIVER
	select USE_NSING_DBG
	help
	  Enable hardware information support for Nations Technologies N32
	  SoCs. The driver exposes the 96-bit unique device identifier.
```

## drivers/i2c/Kconfig.n32
```kconfig
# Copyright (c) 2024 Nations Technologies
# SPDX-License-Identifier: Apache-2.0

config I2C_N32
	bool "N32 MCU I2C driver"
	default y
	depends on I2C
	depends on SOC_FAMILY_NSING_N32
	select USE_NSING_I2C
	help
	  Enable I2C support on the N32 family of processors.

config I2C_N32_BUS_RECOVERY
	bool "Bus recovery support"
	default y if I2C_BUS_RECOVERY
	depends on GPIO
	select I2C_BITBANG
	help
	  Recover a bus a slave is holding low by driving SCL by hand for up
	  to nine cycles, then re-initialising the peripheral. Requires
	  scl-gpios and sda-gpios in devicetree; without them a stuck bus can
	  only be cleared by resetting the peripheral.
```

## drivers/i2s/Kconfig.n32
```kconfig
# Copyright (c) 2024 Nations Technologies
# SPDX-License-Identifier: Apache-2.0

menuconfig I2S_N32
	bool "Nations N32 I2S driver"
	default y
	depends on DT_HAS_NSING_N32_I2S_ENABLED
	select DMA
	select PINCTRL
	select USE_NSING_SPI
	help
	  Enable I2S support on the Nations Technologies N32G45x SoC family.

	  The I2S block is the SPI block in I2S mode, so a given instance serves
	  either this driver or the SPI driver, never both. Both halves of the
	  vendor HAL live in n32g45x_spi.c, which is why USE_NSING_SPI is
	  selected here as well.

if I2S_N32

config I2S_N32_RX_BLOCK_COUNT
	int "RX queue length"
	default 4
	help
	  Depth of the driver's receive queue, counted in DMA blocks. Each
	  queued block is cfg.block_size bytes taken from the application's
	  memory slab, so the slab should hold at least this many blocks. A
	  block that completes with the queue already full is reported as an
	  overrun (ERROR state).

config I2S_N32_TX_BLOCK_COUNT
	int "TX queue length"
	default 4
	help
	  Depth of the driver's transmit queue, counted in DMA blocks. The
	  driver does not allocate these: they are the blocks the application
	  passes to i2s_write().

endif # I2S_N32
```

## drivers/interrupt_controller/Kconfig.n32
```kconfig
# Copyright (c) 2024 Nations Technologies Inc.
# SPDX-License-Identifier: Apache-2.0

config GPIO_INTC_N32
	bool "N32 GPIO Interrupt/Event Controller (EXTI) Driver"
	default y
	depends on DT_HAS_NSING_N32_EXTI_ENABLED
	help
	  Enable the N32 GPIO interrupt controller (EXTI) driver.
```

## drivers/mspi/Kconfig.n32
```kconfig
# Copyright (c) 2024 Nations Technologies Inc.
# SPDX-License-Identifier: Apache-2.0

config MSPI_N32
	bool "Nations N32 quad-SPI controller driver"
	default y
	depends on DT_HAS_NSING_N32_QSPI_ENABLED
	select PINCTRL if $(dt_compat_any_has_prop,$(DT_COMPAT_NSING_N32_QSPI),pinctrl-0)
	select DMA if $(dt_compat_any_has_prop,$(DT_COMPAT_NSING_N32_QSPI),dmas)
	help
	  Enable the QSPI controller driver for the N32G45x family.

	  A device node with a transmit DMA channel in its dmas property lets the
	  driver send a packet longer than its FIFO by handing the payload to that
	  channel. The controller is too slow to be fed from the CPU at its own
	  bus clock, so a node without one can only read.

config MSPI_N32_TX_DMA_FRAMES
	int "N32 QSPI transmit DMA bounce buffer, in frames"
	depends on MSPI_N32
	default 256
	help
	  Frames the driver is willing to hand to the transmit DMA channel. The
	  channel reads words out of memory, one per frame, so this is four times
	  as many bytes of RAM as it says, and it has to cover the frames of a
	  packet that the FIFO could not hold: the handover is one block, and a
	  packet that does not fit is refused rather than truncated.

	  The default covers a 256 byte page program, which is the largest packet
	  the MSPI NOR flash layer issues. Lowering it below that leaves the driver
	  unable to program a flash page; a SPI NOR device with larger pages, or a
	  caller that builds its own packets, needs it raised.
```

## drivers/opamp/Kconfig.n32
```kconfig
# Copyright (c) 2026 Nations Technologies
# SPDX-License-Identifier: Apache-2.0

config OPAMP_N32
	bool "Nations N32G45x OPAMP driver"
	default y
	depends on DT_HAS_NSING_N32_OPAMP_ENABLED
	select PINCTRL
	select USE_NSING_OPAMP
	help
	  Enable the operational amplifier (OPAMP) driver for the Nations
	  N32G45x SoC.  Each of the 4 OPAMPs is a separate Zephyr opamp
	  device.
```

## drivers/pinctrl/Kconfig.n32
```kconfig
# Copyright (c) 2023, Quincy.W <wangqyfm@foxmail.com>
# SPDX-License-Identifier: Apache-2.0

config PINCTRL_N32
	bool "PINCTRL Driver for N32 family of MCUs"
    default y
	depends on PINCTRL
	depends on SOC_FAMILY_NSING_N32
```

## drivers/pwm/Kconfig.n32
```kconfig
# Copyright (c) 2026 Nations Technologies
# SPDX-License-Identifier: Apache-2.0

config PWM_N32
	bool "N32 timer PWM driver"
	default y
	depends on DT_HAS_NSING_N32_PWM_ENABLED
	select USE_NSING_TIM
	select PINCTRL
	help
	  Enable PWM output using the general-purpose and advanced N32 timers.
```

## drivers/reset/Kconfig.nsing
```kconfig
# Copyright (c) 2026 Nations Technologies
# SPDX-License-Identifier: Apache-2.0

config RESET_N32
	bool "Nations N32 reset controller driver"
	default y
	depends on DT_HAS_NSING_N32_RCC_RCTL_ENABLED
```

## drivers/rtc/Kconfig.n32
```kconfig
# Copyright (c) 2026 Nations Technologies Inc.
# SPDX-License-Identifier: Apache-2.0

config RTC_N32
	bool "N32 RTC driver"
	default y
	depends on DT_HAS_NSING_N32_RTC_ENABLED
	select USE_NSING_RTC
	help
	  Build the RTC driver for Nations Technologies N32 SoCs.

	  The RTC clock source (lse/lsi/hse-div128) is a board level
	  decision declared through the nsing,rtc-clock-source devicetree
	  property, since the board may not carry a 32.768 kHz crystal.
```
