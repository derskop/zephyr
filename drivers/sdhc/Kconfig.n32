## drivers/sdhc/Kconfig.n32
```kconfig
# N32 SDIO configuration options

# Copyright (c) 2026
# SPDX-License-Identifier: Apache-2.0

config SDHC_N32
	bool "Nations Technologies N32 SDIO host controller driver"
	default y
	depends on DT_HAS_NSING_N32_SDIO_ENABLED
	select PINCTRL
	select SDHC_SUPPORTS_NATIVE_MODE
	help
	  Enable the Nations Technologies N32 SDIO host controller driver. The
	  controller supports native SD operation with one-bit and four-bit bus
	  widths at 3.3 V. The initial implementation uses programmed I/O (PIO);
	  DMA is not enabled.
```

## drivers/serial/Kconfig.n32
```kconfig
# Copyright (c) 2023, Quincy.W <wangqyfm@foxmail.com>
# SPDX-License-Identifier: Apache-2.0

config UART_N32
	bool "N32 MCU uart driver"
	default y
	depends on SERIAL
	depends on SOC_FAMILY_NSING_N32
	select SERIAL_HAS_DRIVER
	select USE_NSING_USART
   # select SERIAL_SUPPORT_INTERRUPT
	help
	  This option enables the UART driver for N32 family of processors.
```

## drivers/spi/Kconfig.n32
```kconfig
# Copyright (c) 2024 Nations Technologies
# SPDX-License-Identifier: Apache-2.0

menuconfig SPI_N32
	bool "N32 SPI controller driver"
	default y
	depends on DT_HAS_NSING_N32_SPI_ENABLED
	select USE_NSING_SPI
	help
	  Enable SPI support on the Nations Technologies N32 SoC family.
```

## drivers/watchdog/Kconfig.nsing
```kconfig
# Copyright (c) 2026 Nations Technologies
# SPDX-License-Identifier: Apache-2.0

config WDT_N32_IWDG
	bool "Nations N32 independent watchdog driver"
	default y
	depends on DT_HAS_NSING_N32_IWDG_ENABLED
	help
	  Enable the independent watchdog (IWDG) driver for Nations N32 MCUs.

config WDT_N32_WWDG
	bool "Nations N32 window watchdog driver"
	default y
	depends on DT_HAS_NSING_N32_WWDG_ENABLED
	help
	  Enable the window watchdog (WWDG) driver for Nations N32 MCUs.
```

## dts/bindings/adc/nsing,n32-adc.yaml
```yaml
# Copyright (c) 2024 Nations Technologies
# SPDX-License-Identifier: Apache-2.0

description: Nations Technologies N32 ADC

compatible: "nsing,n32-adc"

include: [adc-controller.yaml, pinctrl-device.yaml]

properties:
  reg:
    required: true

  clocks:
    required: true

  pinctrl-0:
    type: phandles
    required: false
    description: |
        GPIO pin configuration for ADC input. The phandles are
        expected to reference pinctrl nodes, e.g.
           pinctrl-0 = <&adc1_channel_01_pa0 &adc1_channel_02_pa1>;

  interrupts:
    required: true

  "#io-channel-cells":
    const: 1
      
  pinctrl-names:
    required: true  
      
  channels:
    type: int
    description: Number of external channels
    required: true   

io-channel-cells:
    - input
```

## dts/bindings/arm/nsing,n32g45xml_stb.yaml
```yaml
# Copyright (c) 2024 Nations Technologies
# SPDX-License-Identifier: Apache-2.0

description: N32G45X Discovery board

compatible: "nsing,n32g45xml_stb"
```

## dts/bindings/clock/nsing,n32-pll-clock.yaml
```yaml
# Copyright (c) 2024 Nasing Technologies
# SPDX-License-Identifier: Apache-2.0

description: Nsing Technologies N32 PLL clock

compatible: "nsing,n32-pll-clock"

include: [base.yaml, clock-controller.yaml]

properties:
  "#clock-cells":
    const: 0

  clocks:
    required: true

  mul:
    type: int
    required: true
    description: |
        Main PLL multiplication factor for VCO
        Valid range: 2 - 16
```

## dts/bindings/clock/nsing,n32-rcc.yaml
```yaml
# Copyright (c) 2024 Nations Technologies
# SPDX-License-Identifier: Apache-2.0

description: Nations Technologies N32 Reset and Clock Control (RCC)

compatible: "nsing,n32-rcc"

include: [base.yaml, clock-controller.yaml]

properties:
  reg:
    required: true

  "#clock-cells":
    const: 1

  clock-frequency:
    type: int
    required: true
    description: |
      SYSCLK in Hz, as the vendor SystemInit() programs it. Unlike the bus
      clocks, which the driver derives from RCC by reading the prescaler
      fields back, SYSCLK cannot be recovered from a register, so it is
      declared here. It is also the source of SYS_CLOCK_HW_CYCLES_PER_SEC
      and of the I2S frame clock prescaler.

clock-cells:
  - bits
```

## dts/bindings/comparator/nsing,n32-comp.yaml
```yaml
# Copyright (c) 2026 Nations Technologies
# SPDX-License-Identifier: Apache-2.0

description: |
  Nations Technologies N32G45x comparator (COMP)

  The N32G45x integrates 7 independent comparators (COMP1..COMP7) sharing
  one APB1 peripheral block.  Each comparator is exposed as its own
  Zephyr comparator device, identified by its own devicetree node whose
  "reg" points at the COMPx_CTRL register block
  (0x40002410 + (x-1)*0x10).

  e.g.:

    comp1: comparator@40002410 {
      compatible = "nsing,n32-comp";
      reg = <0x40002410 0x10>;
      clocks = <&rcc N32_CLOCK_COMP>;
      positive-input = "PA1";
      negative-input = "VREF1";
      hysteresis = "NONE";
      status = "okay";
    };

  The comparator interrupt lines are shared: COMP1/2/3 -> IRQ 82,
  COMP4/5/6 -> IRQ 83, COMP7 -> IRQ 84.  Only one comparator of a group
  can therefore use trigger callbacks at a time.  The SoC dtsi wires
  the "interrupts" property on the first comparator of each group
  (comp1, comp4, comp7); move it to another comparator of the group if
  needed, keeping a single interrupt-capable comparator per group.

  NOTE: positive-input/negative-input values are instance specific.
  When a value is not routable to the selected comparator instance the
  driver fails initialization with -EINVAL.

include:
  - base.yaml
  - pinctrl-device.yaml

compatible: "nsing,n32-comp"

properties:
  reg:
    required: true
  clocks:
    required: true
  interrupts:
    required: false

  positive-input:
    type: string
    description: |
      Selects the non-inverting (+) input source of this comparator.
      May be an external pad (the pad must additionally be configured
      analog via pinctrl on the board) or, for some instances, a DAC
      output.  See the driver lookup table for reachability.
    enum:
      - PA1
      - PB10
      - PB11
      - PA7
      - PB14
      - PB0
      - PC9
      - PB15
      - PC4
      - PC3
      - PA3
      - PC5
      - PD9
      - PC1

  negative-input:
    type: string
    description: |
      Selects the inverting (-) input source of this comparator.  May be
      an external pad, a DAC channel, or one of the two internal
      reference scalers VREF1/VREF2 (enable/trim controlled by
      n32,vref1-trim / n32,vref2-trim).
    enum:
      - PA0
      - PB1
      - PB12
      - PC4
      - PB10
      - PA7
      - PC0
      - PE8
      - PE7
      - PB13
      - PD10
      - PD8
      - DAC1
      - DAC2
      - VREF1
      - VREF2

  hysteresis:
    type: string
    description: |
      Selects the hysteresis level.  Hysteresis offsets the comparison
      threshold to avoid output toggling on noisy / slowly varying
      inputs.
    enum:
      - NONE
      - LOW
      - MEDIUM
      - HIGH
    default: NONE

  invert-output:
    type: string
    description: |
      Output polarity selection (COMPx_CTRL.POL).  When INVERTED the
      comparator output is inverted.
    enum:
      - NONINVERTED
      - INVERTED
    default: NONINVERTED

  lock-enable:
    type: boolean
    description: |
      Lock this comparator configuration (COMP_LOCK).  Once locked the
      comparator registers become read-only until the next system reset.

  n32,vref1-trim:
    type: int
    default: 0
    description: |
      6-bit trim value (0..63) of the VREF1 scaler.  Only used when
      negative-input selects VREF1.  The scaler output voltage follows
      the trim value; consult UM_N32G45x_COMP for the exact scaling.
      The trim of both scalers is shared between all comparators.

  n32,vref2-trim:
    type: int
    default: 0
    description: |
      6-bit trim value (0..63) of the VREF2 scaler.  Only used when
      negative-input selects VREF2.
```

## dts/bindings/dac/nsing,n32-dac.yaml
```yaml
# Copyright (c) 2024 Nations Technologies
# SPDX-License-Identifier: Apache-2.0

description: Nations Technologies N32 digital-to-analog converter

compatible: "nsing,n32-dac"

include: [dac-controller.yaml, pinctrl-device.yaml]

properties:
  reg:
    required: true

  clocks:
    required: true

  "#io-channel-cells":
    const: 1

  num-channels:
    type: int
    required: true
    description: Number of DAC channels

  pinctrl-0:
    type: phandles
    description: DAC output pins in analog mode

io-channel-cells:
  - output
```

## dts/bindings/dma/nsing,n32-dma.yaml
```yaml
# Copyright (c) 2024 Nations Technologies
# SPDX-License-Identifier: Apache-2.0

description: |
  Nations Technologies N32 DMA controller

  channel: Select channel for data transmitting

  request: Peripheral request selector, written to the channel's CHSEL
    register. Use one of the N32_DMA1_REQ_* / N32_DMA2_REQ_* macros from
    include/zephyr/dt-bindings/dma/n32_dma.h, or 0 to leave the channel on its
    hardwired default mapping.

    The hardware remaps requests through a per-channel CHSEL register gated by
    a single controller-wide CHMAPEN bit. Programming CHSEL for one channel
    therefore changes how every other channel of the same controller is
    decoded, so a controller cannot mix channels left on the default mapping
    (request 0) with channels carrying an explicit request code. dma_config()
    returns -EINVAL if it is asked to.

    Note that N32_DMA1_REQ_ADC1 and N32_DMA2_REQ_TIM5_CH4 are 0x00, the same
    value as "use the default mapping", so those two requests cannot be
    remapped onto another channel.

  config: A bitmask of static channel configuration, built from the
    N32_DMA_CH_CFG_* macros in include/zephyr/dt-bindings/dma/n32_dma.h —
    for example N32_DMA_CH_CFG_PRIORITY(N32_DMA_PRIORITY_HIGH).
    Direction, data widths and address incrementation are driven by the
    runtime fields of struct dma_config and are ignored if set here; the cell
    exists for the settings the runtime struct cannot express, mainly channel
    priority. A consumer typically decodes it like:

      dma_cfg.channel_priority =
          N32_DMA_CH_CFG_PRIORITY_GET(DT_INST_DMAS_CELL_BY_NAME(idx, tx, config));

    Pass 0 to leave priority at its default.

  Example of devicetree configuration

  &spi2 {
        dmas = <&dma1 3 N32_DMA1_REQ_SPI_I2S2_RX
                       N32_DMA_CH_CFG_PRIORITY(N32_DMA_PRIORITY_HIGH)>,
               <&dma1 4 N32_DMA1_REQ_SPI_I2S2_TX
                       N32_DMA_CH_CFG_PRIORITY(N32_DMA_PRIORITY_HIGH)>;
        dma-names = "rx", "tx";
  };

  "spi2" receives on dma1 channel 3 and transmits on dma1 channel 4, both
  remapped to the SPI2/I2S2 request, both at high priority. Both cells need
  <zephyr/dt-bindings/dma/n32_dma.h> to be included by the file using them.

compatible: "nsing,n32-dma"

include: [dma-controller.yaml]

properties:
  reg:
    required: true

  clocks:
    required: true

  interrupts:
    required: true

  dma-channels:
    required: true

  nsing,mem2mem:
    type: boolean
    description: The DMA controller supports memory to memory transfer

  "#dma-cells":
    const: 3

dma-cells:
  - channel
  - request
  - config
```

## dts/bindings/ethernet/mdio/nsing,n32-mdio.yaml
```yaml
# Copyright (c) 2026 Nations Technologies
# SPDX-License-Identifier: Apache-2.0

title: Nations Technologies N32 MDIO controller

description: |
  Nations Technologies N32 series Ethernet MAC MDIO controller.

compatible: "nsing,n32-mdio"

include:
  - name: mdio-controller.yaml
  - name: pinctrl-device.yaml

examples:
  - |
    &mdio {
      compatible = "nsing,n32-mdio";
    };
```

## dts/bindings/ethernet/nsing,n32-eth.yaml
```yaml
# Copyright (c) 2026 Nations Technologies
# SPDX-License-Identifier: Apache-2.0

title: Nations Technologies N32 Ethernet MAC

description: |
  Nations Technologies N32 series Ethernet MAC with DMA.

compatible: "nsing,n32-eth"

include:
  - name: ethernet-controller.yaml
  - name: pinctrl-device.yaml

properties:
  reg:
    required: true
  clocks:
    required: true
  interrupts:
    required: true
  pinctrl-0:
    required: true
  pinctrl-names:
    required: true
  phy-handle:
    required: true
  phy-connection-type:
    required: true
```

## dts/bindings/gpio/nsing,n32-gpio.yaml
```yaml
# Copyright (c) 2024 Nations Technologies
# SPDX-License-Identifier: Apache-2.0

description: Nations Technologies N32 GPIO controller

compatible: "nsing,n32-gpio"

include: [gpio-controller.yaml, base.yaml]

properties:
  reg:
    required: true

  clocks:
    required: true

  "#gpio-cells":
    const: 2

gpio-cells:
  - pin
  - flags
```

## dts/bindings/i2c/nsing,n32-i2c.yaml
```yaml
# Copyright (c) 2024 Nations Technologies
# SPDX-License-Identifier: Apache-2.0

description: Nsing Technologies N32 I2C controller

compatible: "nsing,n32-i2c"

include: [i2c-controller.yaml, pinctrl-device.yaml]

properties:
  reg:
    required: true

  clocks:
    required: true

  interrupts:
    required: true

  scl-gpios:
    type: phandle-array
    description: |
      GPIO the I2C SCL signal is routed to. Only needed for bus recovery,
      which drives SCL by hand to clock a slave that is holding SDA low
      back to idle. Without it the driver cannot recover a stuck bus.

  sda-gpios:
    type: phandle-array
    description: |
      GPIO the I2C SDA signal is routed to. Only needed for bus recovery,
      see scl-gpios.
```
