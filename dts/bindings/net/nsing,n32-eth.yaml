## dts/bindings/net/nsing,n32-eth.yaml
```yaml
# Copyright (c) 2024 Nations Technologies
# SPDX-License-Identifier: Apache-2.0

description: Nations Technologies N32 Ethernet MAC

compatible: "nsing,n32-eth"

include: [base.yaml]

properties:
  reg:
    required: true
  clocks:
    required: true
  interrupts:
    required: true
```

## dts/bindings/opamp/nsing,n32-opamp.yaml
```yaml
# Copyright (c) 2026 Nations Technologies
# SPDX-License-Identifier: Apache-2.0

description: |
  Nations Technologies N32G45x operational amplifier (OPAMP)

  The N32G45x integrates 4 independent operational amplifiers
  (OPAMP1..OPAMP4).  Each amplifier may be driven by its own
  devicetree node, e.g.:

    opamp1: opamp@40002000 {
      compatible = "nsing,n32-opamp";
      reg = <0x40002000 0x10>;
      clocks = <&rcc N32_CLOCK_OPAMP>;
      functional-mode = "non_inverting";
      positive-input = "PA1";
      status = "okay";
    };

  Supported functional modes (see opamp-controller.yaml for the
  full list):
    - "non_inverting": internal PGA, programmable gain x2/x4/x8/x16/x32
    - "follower":      internal follower (gain fixed to x1)
    - "standalone":    external op-amp, gain set by external resistors

  The internal resistive network of the N32G45x only provides
  non-inverting PGA gains, so the "inverting" and "differential"
  modes must be implemented with an external network.  Configuring
  one of those modes makes the driver fail with -EINVAL; use
  "standalone" instead for external-network amplifiers.

  NOTE: positive-input values are instance specific.  When a value
  is not routable to the selected OPAMP instance the driver fails
  initialization with -EINVAL.

include:
  - opamp-controller.yaml

compatible: "nsing,n32-opamp"

properties:
  reg:
    required: true
  clocks:
    required: true

  positive-input:
    type: string
    description: |
      Selects the non-inverting (+) input source.  Each OPAMP can be
      muxed to a subset of these pads/internal signals (see the
      "positive-input" lookup table in the driver); selecting an input
      that is not reachable by the instance fails initialization.
    enum:
      - PA1
      - PA3
      - PA7
      - PB0
      - PE8
      - PC9
      - PC3
      - PC5
      - DAC1
      - DAC2

  negative-input:
    type: string
    description: |
      Selects the inverting (-) input source.  Only meaningful in
      "standalone" mode; in "follower" and "non_inverting" modes the
      inverting input is internally forced to the required connection
      (follower: output shorted to inverting input; PGA: floating).
    enum:
      - PA2
      - PA3
      - PA5
      - PC4
      - PB10
      - PC9
      - PD8
      - FLOAT
```

## dts/bindings/pinctrl/nsing,n32g45-pinctrl.yaml
```yaml
# Copyright (c) 2024 Nations Technologies Inc.
# SPDX-License-Identifier: Apache-2.0

description: Nations N32G45x pin controller

compatible: "nsing,n32g45-pinctrl"

include: base.yaml

properties:
  reg:
    required: true
  "#address-cells":
    required: true
    const: 1
  "#size-cells":
    required: true
    const: 1

child-binding:
  description: |
    Pin configuration node. pinmux is encoded by the N32G45X_PINMUX()
    macro from <zephyr/dt-bindings/pinctrl/n32g45x-pinctrl.h>.
  include:
    - name: pincfg-node.yaml
      property-allowlist:
        - bias-disable
        - bias-pull-up
        - bias-pull-down
        - drive-open-drain
        - drive-push-pull
        - output-high
        - output-low
  properties:
    pinmux:
      type: int
      required: true
    slew-rate:
      type: string
      default: "2mhz"
      enum:
        - "2mhz"
        - "10mhz"
        - "50mhz"
```

## dts/bindings/power/nsing,n32-pwr.yaml
```yaml
# Copyright (c) 2024 Nations Technologies
# SPDX-License-Identifier: Apache-2.0

description: Nations Technologies N32 power control

compatible: "nsing,n32-pwr"

include: [base.yaml]

properties:
  reg:
    required: true
  clocks:
    required: true
```

## dts/bindings/pwm/nsing,n32-pwm.yaml
```yaml
# Copyright (c) 2026 Nations Technologies
# SPDX-License-Identifier: Apache-2.0

description: Nations Technologies N32 timer PWM controller

compatible: "nsing,n32-pwm"

include: [pwm-controller.yaml, base.yaml, pinctrl-device.yaml]

properties:
  "#pwm-cells":
    const: 3

pwm-cells:
  - channel
  - period
  - flags
```

## dts/bindings/reset/nsing,n32-rcc-rctl.yaml
```yaml
# Copyright (c) 2026 Nations Technologies
# SPDX-License-Identifier: Apache-2.0

description: Nations N32 Reset and Clock Control (RCC) reset controller

compatible: "nsing,n32-rcc-rctl"

include: [reset-controller.yaml, base.yaml]

properties:
  "#reset-cells":
    const: 1

reset-cells:
  - id
```

## dts/bindings/rtc/nsing,n32-rtc.yaml
```yaml
# Copyright (c) 2024 Nations Technologies
# SPDX-License-Identifier: Apache-2.0

description: Nations Technologies N32 real-time clock

compatible: "nsing,n32-rtc"

include: [base.yaml]

properties:
  reg:
    required: true
  interrupts:
    required: true
```

## dts/bindings/sdhc/nsing,n32-sdio.yaml
```yaml
# SPDX-License-Identifier: Apache-2.0
# Copyright (c) 2026

description: Nations Technologies N32 SDIO host controller

compatible: "nsing,n32-sdio"

include: [sdhc.yaml, pinctrl-device.yaml]

properties:
  reg:
    required: true

  clocks:
    required: true

  interrupts:
    required: true

  pinctrl-0:
    required: true

  pinctrl-names:
    required: true

  bus-width:
    type: int
    default: 1
    enum:
      - 1
      - 4
    description: Number of SD data lines connected to the card
```

## dts/bindings/serial/nsing,n32-uart.yaml
```yaml
# Copyright (c) 2024 Nations Technologies
# SPDX-License-Identifier: Apache-2.0

description: Nations Technologies N32 UART/USART

compatible: "nsing,n32-uart"

include: [base.yaml, pinctrl-device.yaml]

properties:
  reg:
    required: true

  clocks:
    required: true

  current-speed:
  
    type: int
    required: false

  interrupts:
    required: true
```

## dts/bindings/spi/nsing,n32-qspi.yaml
```yaml
# Copyright (c) 2024 Nations Technologies
# SPDX-License-Identifier: Apache-2.0

description: Nations Technologies N32 quad-SPI controller

compatible: "nsing,n32-qspi"

include: [base.yaml]

properties:
  reg:
    required: true
  clocks:
    required: true
  interrupts:
    required: true
```

## dts/bindings/spi/nsing,n32-spi.yaml
```yaml
# Copyright (c) 2024 Nations Technologies
# SPDX-License-Identifier: Apache-2.0

description: Nations Technologies N32 SPI controller

compatible: "nsing,n32-spi"

include: [spi-controller.yaml, pinctrl-device.yaml]

properties:
  reg:
    required: true

  clocks:
    required: true

  interrupts:
    required: true
```

## dts/bindings/timer/nsing,n32-tim.yaml
```yaml
# Copyright (c) 2024 Nations Technologies
# SPDX-License-Identifier: Apache-2.0

description: Nations Technologies N32 general-purpose/advanced timer

compatible: "nsing,n32-tim"

include: [base.yaml]

properties:
  reg:
    required: true
  clocks:
    required: true
  interrupts:
    required: true
  prescaler:
    type: int
    default: 0
    description: Timer clock prescaler value (actual division is prescaler + 1).
  channels:
    type: int
    required: true
    description: Number of capture/compare channels implemented by the timer.
  advanced:
    type: boolean
    description: Timer has the advanced-control main output enable bit.
```

## dts/bindings/usb/nsing,n32-usb.yaml
```yaml
# Copyright (c) 2026 Nations Technologies
# SPDX-License-Identifier: Apache-2.0

description: Nations Technologies N32G45x USB FS device controller

compatible: "nsing,n32-usb"

include: [usb-ep.yaml]

properties:
  reg:
    required: true

  interrupts:
    required: true

  ram-size:
    type: int
    required: true
    description: |
      Size of USB dedicated packet memory area (PMA), in bytes.

  clocks:
    required: true
```

## dts/bindings/watchdog/nsing,n32-iwdg.yaml
```yaml
# Copyright (c) 2024 Nations Technologies
# SPDX-License-Identifier: Apache-2.0

description: Nations Technologies N32 independent watchdog

compatible: "nsing,n32-iwdg"

include: [base.yaml]

properties:
  reg:
    required: true
```

## dts/bindings/watchdog/nsing,n32-wwdg.yaml
```yaml
# Copyright (c) 2024 Nations Technologies
# SPDX-License-Identifier: Apache-2.0

description: Nations Technologies N32 window watchdog

compatible: "nsing,n32-wwdg"

include: [base.yaml]

properties:
  reg:
    required: true
  clocks:
    required: true
  interrupts:
    required: true
```

## modules/hal_nsing/Kconfig
```kconfig
# Nationstech N32 firmware library config
#
# Copyright (c) 2024 Nations Technologies
# SPDX-License-Identifier: Apache-2.0

config HAS_NSING_HAL
	bool
	select HAS_CMSIS_CORE if ARM

if HAS_NSING_HAL

config USE_NSING_MISC
	bool
	help
	  Enable N32 Miscellaneous (MISC) HAL module driver

config USE_NSING_ADC
	bool
	help
	  Enable N32 Analog-to-Digital Converter (ADC) HAL module driver

config USE_NSING_BKP
	bool
	help
	  Enable N32 Backup Registers (BKP) HAL module driver

config USE_NSING_CAN
	bool
	help
	  Enable N32 Controller Area Network (CAN) HAL module driver

config USE_NSING_COMP
	bool
	help
	  Enable N32 Comparator (COMP) HAL module driver

config USE_NSING_CRC
	bool
	help
	  Enable N32 Cyclic redundancy check (CRC) HAL module driver

config USE_NSING_DAC
	bool
	help
	  Enable N32 Digital-to-Analog Converter (DAC) HAL module driver

config USE_NSING_DBG
	bool
	help
	  Enable N32 Debug (DBG) HAL module driver

config USE_NSING_DMA
	bool
	help
	  Enable N32 Direct Memory Access (DMA) HAL module driver

config USE_NSING_DVP
	bool
	help
	  Enable N32 Digital Video Port (DVP) HAL module driver

config USE_NSING_ETH
	bool
	help
	  Enable N32 Ethernet (ETH) HAL module driver

config USE_NSING_EXTI
	bool
	help
	  Enable N32 External Interrupt (EXTI) HAL module driver

config USE_NSING_FLASH
	bool
	help
	  Enable N32 Flash Memory Controller (FLASH) HAL module driver

config USE_NSING_GPIO
	bool
	default y
	help
	  Enable N32 General-purpose I/O (GPIO) HAL module driver

config USE_NSING_I2C
	bool
	help
	  Enable N32 Inter-Integrated Circuit (I2C) HAL module driver

config USE_NSING_IWDG
	bool
	help
	  Enable N32 Independent Watchdog (IWDG) HAL module driver

config USE_NSING_OPAMP
	bool
	help
	  Enable N32 Operational Amplifier (OPAMP) HAL module driver

config USE_NSING_PWR
	bool
	help
	  Enable N32 Power Management (PWR) HAL module driver

config USE_NSING_QSPI
	bool
	help
	  Enable N32 Quad SPI (QSPI) HAL module driver

config USE_NSING_RCC
	bool
	default y
	help
	  Enable N32 Reset and Clock Control (RCC) HAL module driver

config USE_NSING_RTC
	bool
	help
	  Enable N32 Real-Time Clock (RTC) HAL module driver

config USE_NSING_SDIO
	bool
	help
	  Enable N32 Secure Digital I/O (SDIO) HAL module driver

config USE_NSING_SPI
	bool
	help
	  Enable N32 Serial Peripheral Interface (SPI) HAL module driver

config USE_NSING_TIM
	bool
	help
	  Enable N32 Timer (TIM) HAL module driver

config USE_NSING_TSC
	bool
	help
	  Enable N32 Touch Sensing Controller (TSC) HAL module driver

config USE_NSING_USART
	bool
	help
	  Enable N32 Universal Synchronous/Asynchronous Receiver/Transmitter
	  (USART) HAL module driver

config USE_NSING_WWDGT
	bool
	help
	  Enable N32 Window Watchdog (WWDGT) HAL module driver

endif # HAS_NSING_HAL
```

## soc/nsing/nsing_n32/Kconfig.defconfig
```kconfig
# Nations Technologies N32 SoC family

# Copyright (c) 2024 Nations Technologies
# SPDX-License-Identifier: Apache-2.0

# 家族级默认值：所有 N32 系列共用的默认配置
if SOC_FAMILY_NSING_N32

# 先加载系列级默认值（n32g45x/Kconfig.defconfig 等），
# 家族级默认值可在其后覆盖
rsource "*/Kconfig.defconfig"


endif # SOC_FAMILY_NSING_N32
```

## soc/nsing/nsing_n32/n32g45x/Kconfig
```kconfig
# Nations Technologies N32G45x MCU series

# Copyright (c) 2024 Nations Technologies
# SPDX-License-Identifier: Apache-2.0

# 系列能力表：声明 N32G45x 系列具备的硬件能力
# 注意：此处只加 select，不重复声明 bool（类型在 Kconfig.soc 里）
config SOC_SERIES_N32G45X
	select ARM
	select CPU_CORTEX_M4
	select CPU_HAS_FPU
	select CPU_HAS_ARM_MPU
	select SOC_EARLY_INIT_HOOK
```

## soc/nsing/nsing_n32/n32g45x/Kconfig.soc
```kconfig
# Nations Technologies N32G45x MCU series

# Copyright (c) 2024 Nations Technologies
# SPDX-License-Identifier: Apache-2.0

# 系列符号：N32G45 系列（N32G452 / G455 / G457）
config SOC_SERIES_N32G45X
	bool
	select SOC_FAMILY_NSING_N32

# 系列字符串：对应目录 soc/nsing/n32g45x/
config SOC_SERIES
	default "n32g45x" if SOC_SERIES_N32G45X

# 具体芯片符号：N32G457（后续如需支持 G452/G455 再补）
config SOC_N32G457MEL
	bool
	select SOC_SERIES_N32G45X

# 芯片字符串
config SOC
	default "n32g45x" if SOC_N32G457MEL
```

## tests/drivers/flash/common/boards/n32g45xml_stb.conf
```kconfig
# Copyright (c) 2026 Nations Technologies
# SPDX-License-Identifier: Apache-2.0

CONFIG_TEST_DRIVER_FLASH_SIZE=524288
```
