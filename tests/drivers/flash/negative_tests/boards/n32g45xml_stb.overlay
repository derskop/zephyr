/*
 * Copyright (c) 2026 Nations Technologies
 *
 * SPDX-License-Identifier: Apache-2.0
 */

&flash0 {
	partitions {
		compatible = "fixed-partitions";
		#address-cells = <1>;
		#size-cells = <1>;

		/* Reserve the final two 2 KiB pages for destructive flash tests. */
		storage_partition: partition@7f000 {
			label = "storage";
			reg = <0x7f000 0x1000>;
		};
	};
};
